## firmware/zephyr-app/boards/others/field_orient_g431/board.yml
```yaml
board:
  name: field_orient_g431
  full_name: Field Orient STM32G431 Custom Board
  vendor: others
  socs:
    - name: stm32g431xx
```

## firmware/zephyr-app/boards/others/field_orient_g431/field_orient_g431_defconfig
```kconfig
CONFIG_CLOCK_CONTROL=y
CONFIG_CLOCK_CONTROL_STM32_CUBE=y
CONFIG_GPIO=y
CONFIG_SERIAL=y
CONFIG_CONSOLE=y
CONFIG_UART_CONSOLE=y
CONFIG_UART_INTERRUPT_DRIVEN=y
CONFIG_PINCTRL=y
CONFIG_I2C=y
CONFIG_PWM=y
CONFIG_ADC=y
CONFIG_MAIN_STACK_SIZE=2048
```
